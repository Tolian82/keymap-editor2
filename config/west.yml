## config/west.yml
```yaml
manifest:
  remotes:
    - name: zmkfirmware
      url-base: https://github.com/zmkfirmware
    - name: DoctorWangWang
      url-base: https://github.com/DoctorWangWang
  projects:
    - name: zmk
      remote: zmkfirmware
      revision: v0.3
      import: app/west.yml
    - name: zmk-pmw3610-driver
      remote: DoctorWangWang
      # Exact upstream main HEAD since 2024-04-13. Avoid floating versions.
      revision: 1d9c2c68ca76012e1b1e5f6ef02fa5eadc4ca399
      
  self:
    path: config
```
